## sdkconfig.defaults
```kconfig
CONFIG_ESPTOOLPY_FLASHSIZE_4MB=y
CONFIG_PARTITION_TABLE_CUSTOM=y
CONFIG_PARTITION_TABLE_CUSTOM_FILENAME="partitions.csv"
CONFIG_PARTITION_TABLE_OFFSET=0xc000

# mbedtls
CONFIG_MBEDTLS_DYNAMIC_BUFFER=y
CONFIG_MBEDTLS_DYNAMIC_FREE_PEER_CERT=y
CONFIG_MBEDTLS_DYNAMIC_FREE_CONFIG_DATA=y
CONFIG_MBEDTLS_CERTIFICATE_BUNDLE_DEFAULT_CMN=y

# BLE for provisioning (NimBLE)
CONFIG_BT_ENABLED=y
CONFIG_BTDM_CTRL_MODE_BLE_ONLY=y
CONFIG_BT_NIMBLE_ENABLED=y

# Timer stack
CONFIG_FREERTOS_TIMER_TASK_STACK_DEPTH=3120

# Security
CONFIG_APP_PROV_SECURITY_VERSION_1=y
CONFIG_ESP_RMAKER_USER_ID_CHECK=y
CONFIG_ESP_RMAKER_LOCAL_CTRL_AUTO_ENABLE=y
CONFIG_ESP_RMAKER_LOCAL_CTRL_SECURITY_1=y

# App rollback
CONFIG_BOOTLOADER_APP_ROLLBACK_ENABLE=y

# Insights (disabled to avoid linker wrap conflicts)
# CONFIG_ESP_INSIGHTS_ENABLED is not set

# LWIP sockets (increase to avoid ENFILE)
CONFIG_LWIP_MAX_SOCKETS=20

# HTTP server
CONFIG_HTTPD_WS_SUPPORT=y
CONFIG_HTTPD_QUEUE_DEPTH=16
CONFIG_HTTPD_TASK_STACK=4096
CONFIG_HTTPD_PURGE_BUF_LEN=512

# Reduce memory usage
CONFIG_COMPILER_OPTIMIZATION_SIZE=y
# CONFIG_COMPILER_OPTIMIZATION_DEBUG is not set

# App network provisioning
CONFIG_APP_NETWORK_PROV_TRANSPORT_BLE=y
CONFIG_APP_NETWORK_PROV_TIMEOUT_PERIOD=5
```
